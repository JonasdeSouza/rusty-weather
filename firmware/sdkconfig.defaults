## firmware/sdkconfig.defaults
```kconfig
CONFIG_ESP_SYSTEM_CHECK_INT_LEVEL_4=y
CONFIG_FREERTOS_HZ=1000
CONFIG_PARTITION_TABLE_CUSTOM=y
CONFIG_PARTITION_TABLE_CUSTOM_FILENAME="partitions.csv"
CONFIG_SPIFFS_MAX_PARTITIONS=3
CONFIG_ESP_MAIN_TASK_STACK_SIZE=8192

# Otimizações para timing preciso do DHT11
CONFIG_ESP_TIMER_INTERRUPT_LEVEL=1
CONFIG_FREERTOS_INTERRUPT_BACKTRACE=n
```
